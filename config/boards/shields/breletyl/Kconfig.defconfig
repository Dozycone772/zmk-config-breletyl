## config/boards/shields/breletyl/Kconfig.defconfig
```kconfig
if SHIELD_BRELETYL_LEFT

config ZMK_KEYBOARD_NAME
	default "BRELETYL"

config ZMK_SPLIT_ROLE_CENTRAL
	default y

endif

if SHIELD_BRELETYL_LEFT || SHIELD_BRELETYL_RIGHT

config ZMK_SPLIT
	default y

endif
```

## config/boards/shields/breletyl/Kconfig.shield
```kconfig
config SHIELD_BRELETYL_LEFT
	def_bool $(shields_list_contains,breletyl_left)

config SHIELD_BRELETYL_RIGHT
	def_bool $(shields_list_contains,breletyl_right)
```
